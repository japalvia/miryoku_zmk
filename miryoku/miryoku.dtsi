// Copyright 2022 Manna Harbour
// https://github.com/manna-harbour/miryoku
// vim: set ts=2 sw=2 et ai:

#include <behaviors.dtsi>
#include <behaviors/mouse_key_press.dtsi>
#if defined (MIRYOKU_KLUDGE_MOUSEKEYSPR)
  #include <behaviors/mouse_move.dtsi>
  #include <behaviors/mouse_scroll.dtsi>
#endif
#include <dt-bindings/zmk/keys.h>
#include <dt-bindings/zmk/bt.h>
#include <dt-bindings/zmk/rgb.h>
#include <dt-bindings/zmk/outputs.h>
#include <dt-bindings/zmk/ext_power.h>

#include "miryoku.h"

#include <dt-bindings/zmk/mouse.h>

/ {
  macros {
    a_uml: a_uml {
      compatible = "zmk,behavior-macro";
      #binding-cells = <0>;
      bindings
      = <&macro_tap &kp RA(A) &kp DOUBLE_QUOTES>
      ;
    };
    o_uml: o_uml {
      compatible = "zmk,behavior-macro";
      #binding-cells = <0>;
      bindings
      = <&macro_tap &kp RA(O) &kp DOUBLE_QUOTES>
      ;
    };
  };

  keymap {
    compatible = "zmk,keymap";
#define MIRYOKU_X(LAYER, STRING) \
    LAYER { \
      display-name = STRING; \
      bindings = < U_MACRO_VA_ARGS(MIRYOKU_LAYERMAPPING_##LAYER, MIRYOKU_LAYER_##LAYER) >; \
    };
MIRYOKU_LAYER_LIST
#undef MIRYOKU_X
  };
};

#include "miryoku_shift_functions.dtsi"

#include "miryoku_double_tap_guard.dtsi"

#if defined (MIRYOKU_KLUDGE_MOUSEKEYSPR)
  #include "miryoku_kludge_mousekeyspr.dtsi"
#else
  #include "miryoku_mousekeys.dtsi"
#endif

#if defined (MIRYOKU_KLUDGE_THUMBCOMBOS)
  #include "miryoku_kludge_thumbcombos.dtsi"
#endif

#if defined (MIRYOKU_KLUDGE_TOPROWCOMBOS)
  #include "miryoku_kludge_toprowcombos.dtsi"
#endif

#if defined (MIRYOKU_KLUDGE_BOTTOMROWCOMBOS)
  #include "miryoku_kludge_bottomrowcombos.dtsi"
#endif

#if defined (MIRYOKU_KLUDGE_TAPDELAY)
  #include "miryoku_kludge_tapdelay.dtsi"
#else
  #include "miryoku_behaviors.dtsi"
#endif
